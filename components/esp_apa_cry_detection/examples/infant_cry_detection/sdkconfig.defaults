## components/esp_apa_cry_detection/examples/infant_cry_detection/sdkconfig.defaults.esp32p4
```kconfig
# ESP32-P4 (function EV).

CONFIG_ESP_DEFAULT_CPU_FREQ_MHZ_400=y
CONFIG_CACHE_L2_CACHE_LINE_64B=y

CONFIG_SPIRAM_MODE_HEX=y
CONFIG_SPIRAM_SPEED_200M=y
```

## components/esp_apa_doa/examples/live_example/sdkconfig.defaults
```kconfig
# Target: ESP32-S31-Korvo-1, 2-mic linear DOA live example

CONFIG_IDF_TARGET="esp32s31"

CONFIG_ESP_DEFAULT_CPU_FREQ_MHZ_320=y
CONFIG_ESPTOOLPY_FLASHMODE_QIO=y
CONFIG_ESPTOOLPY_FLASHFREQ_80M=y
CONFIG_ESPTOOLPY_FLASHSIZE_16MB=y
CONFIG_FREERTOS_HZ=1000
CONFIG_ESP_MAIN_TASK_STACK_SIZE=6144

CONFIG_SPIRAM=y
CONFIG_SPIRAM_MODE_OCT=y
CONFIG_SPIRAM_SPEED_80M=y
CONFIG_SPIRAM_ALLOW_BSS_SEG_EXTERNAL_MEMORY=y
CONFIG_SPIRAM_ALLOW_NOINIT_SEG_EXTERNAL_MEMORY=y

CONFIG_CODEC_ES8389_SUPPORT=y
CONFIG_CODEC_ES7210_SUPPORT=n
CONFIG_CODEC_ES8311_SUPPORT=n
CONFIG_CODEC_I2C_BACKWARD_COMPATIBLE=n

CONFIG_ESP_APA_DOA_CAP_STREAM_CHANNELS=2
CONFIG_ESP_APA_DOA_CAP_SLOT_MIC0=0
CONFIG_ESP_APA_DOA_CAP_SLOT_MIC1=1
```
